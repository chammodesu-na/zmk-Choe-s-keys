/* I2C 버스 활성화 */
&pro_micro_i2c {
    status = "okay";

    /* ▼ 판매자가 준 코드 그대로 붙여넣기 */
    tps43: iqs5xx@74 {
        status = "okay";
        compatible = "azoteq,iqs5xx";
        reg = <0x74>;

        /* 핀 설정 (이게 핵심입니다) */
        reset-gpios = <&gpio1 1 GPIO_ACTIVE_LOW>;
        rdy-gpios = <&gpio1 2 GPIO_ACTIVE_HIGH>;

        /* 설정 옵션들 */
        one-finger-tap;
        press-and-hold;
        press-and-hold-time = <250>;
        two-finger-tap;

        scroll;
        natural-scroll-y;
        natural-scroll-x;

        bottom-beta = <5>;
        stationary-threshold = <5>;

        switch-xy;
    }; 
};

/* ▼ 이 장치를 ZMK 마우스로 쓰겠다고 등록하는 부분 (필수) */
/ {
    zmk_input_listener {
        compatible = "zmk,input-listener";
        device = <&tps43>;
    };
};
