/ {
    chosen {
        zmk,kscan = &mock_kscan;
        zmk,matrix_transform = &default_transform;
    };

    mock_kscan: kscan_0 {
        compatible = "zmk,kscan-mock";
        columns = <0>;
        rows = <0>;
        events = <0>;
    };
};

/* 필요한 경우 매트릭스 트랜스폼 등을 include */
/* #include "../corne/corne.dtsi" 등을 사용하는 경우도 있음 */
